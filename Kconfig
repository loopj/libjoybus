## Kconfig
```kconfig
menu "libjoybus"

config JOYBUS_ESP32_ISR_IRAM_SAFE
	bool "Keep the Joybus interrupt live during flash writes"
	help
	  Allocate the RMT interrupt with the IRAM flag, so the bus keeps
	  answering while the cache is off for a flash write. Every callback
	  the bus invokes, and every table those read, must then live in RAM,
	  or the first one to run during a write faults.

endmenu
```

## zephyr/Kconfig
```kconfig
menuconfig JOYBUS
	bool "Joybus protocol library"
	help
	  Enable libjoybus, the protocol library for the Nintendo 64 and
	  GameCube serial bus.

if JOYBUS

config JOYBUS_RP2XXX
	bool "RP2xxx Joybus driver"
	default y
	depends on DT_HAS_LOOPJ_JOYBUS_RP2XXX_ENABLED
	depends on PIO_RPI_PICO
	select DYNAMIC_INTERRUPTS
	select PICOSDK_USE_CLAIM
	select PICOSDK_USE_DMA
	select PICOSDK_USE_FLASH
	select PICOSDK_USE_GPIO
	select PICOSDK_USE_PIO
	select PICOSDK_USE_TIMER
	help
	  Drive a bus from an RP2040 or RP2350, with a PIO state machine for
	  the line timing and two DMA channels for the transfer.

if JOYBUS_RP2XXX

config JOYBUS_RP2XXX_IRQ_PRIORITY
	int "RP2xxx Joybus interrupt priority"
	default 1
	help
	  Priority of the PIO and timer interrupts the driver takes. A reply
	  has to start within a few microseconds of the command ending, so
	  keep this ahead of anything that can preempt it.

config JOYBUS_RP2XXX_INIT_PRIORITY
	int "RP2xxx Joybus init priority"
	default 60
	help
	  Device init priority, which has to leave the PIO driver initialized
	  first.

endif # JOYBUS_RP2XXX

config JOYBUS_ESP32
	bool "ESP32 Joybus driver"
	default y
	depends on DT_HAS_LOOPJ_JOYBUS_ESP32_ENABLED
	help
	  Drive a bus from an ESP32, with one RMT channel transmitting and
	  another receiving.

if JOYBUS_ESP32

config JOYBUS_ESP32_INIT_PRIORITY
	int "ESP32 Joybus init priority"
	default 60
	help
	  Device init priority, which decides where the bus comes up among the
	  other POST_KERNEL devices. The driver waits on no other device.

config JOYBUS_ESP32_ISR_IRAM_SAFE
	bool "Keep the Joybus interrupt live during flash writes"
	help
	  Allocate the RMT interrupt with the IRAM flag, so the bus keeps
	  answering while the cache is off for a flash write. Every callback
	  the bus invokes, and every table those read, must then live in RAM,
	  or the first one to run during a write faults.

endif # JOYBUS_ESP32

endif # JOYBUS
```

## zephyr/dts/bindings/joybus/loopj,joybus-esp32.yaml
```yaml
description: Joybus bus on an ESP32, driven by a pair of RMT channels

compatible: "loopj,joybus-esp32"

include: base.yaml

properties:
  gpios:
    type: phandle-array
    required: true
    description: |
      The pin the bus runs on. It is driven open drain and needs a pull up.
      Only the pin number is used, flags are ignored.

  clock-frequency:
    type: int
    default: 250000
    description: Bus frequency in Hz. The default is the rate an OEM controller runs at.

  rmt-tx-channel:
    type: int
    default: 0
    description: |
      Transmit channel to claim, counted from zero among the transmit capable
      channels. Leave the RMT node disabled, or Zephyr's pulse-io driver claims
      the whole peripheral.

  rmt-rx-channel:
    type: int
    default: 0
    description: Receive channel to claim, counted from zero among the receive capable channels.
```

## zephyr/dts/bindings/joybus/loopj,joybus-rp2xxx.yaml
```yaml
description: Joybus bus on an RP2040 or RP2350, driven by a PIO state machine

compatible: "loopj,joybus-rp2xxx"

include: base.yaml

properties:
  gpios:
    type: phandle-array
    required: true
    description: |
      The pin the bus runs on. It is driven open drain and needs a pull up.
      Only the pin number is used, flags are ignored.

  pio:
    type: phandle
    required: true
    description: PIO instance to claim a state machine on.

  clock-frequency:
    type: int
    default: 250000
    description: Bus frequency in Hz. The default is the rate an OEM controller runs at.

  timer:
    type: phandle
    required: true
    description: |
      Timer to claim an alarm on. Leave the timer node disabled, or Zephyr's
      counter driver claims all four of its alarms.

  alarm:
    type: int
    default: 0
    description: Alarm to claim on the timer.
```
