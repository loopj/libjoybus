## examples/esp32/gcn-adapter-usb-hid/sdkconfig.defaults
```kconfig
# USB HID needs native USB-OTG, so build for the ESP32-S3 (idf.py set-target esp32s3).
CONFIG_ESP_CONSOLE_UART_DEFAULT=y
CONFIG_TINYUSB_HID_COUNT=1
```

## examples/esp32/gcn-target/sdkconfig.defaults
```kconfig
# Applied on top of `idf.py set-target esp32s3`.
CONFIG_ESP_CONSOLE_UART_DEFAULT=y
```

## examples/zephyr/joybus-shell/west.yml
```yaml
manifest:
  remotes:
    - name: zephyr
      url-base: https://github.com/zephyrproject-rtos

  projects:
    - name: zephyr
      remote: zephyr
      revision: main
      import:
        name-allowlist:
          - cmsis_6
          - hal_silabs
```
